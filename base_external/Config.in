## base_external/Config.in
```kconfig
source "../base_external/package/aesd-assignments/Config.in"
source "../base_external/package/ldd/Config.in"
source "../base_external/package/aesd-char-driver/Config.in"
```

## base_external/package/aesd-char-driver/Config.in
```kconfig
config BR2_PACKAGE_AESD_CHAR_DRIVER
	bool "aesd_char_driver"
	depends on BR2_LINUX_KERNEL
	help
	  Includes the aesd linux device driver in the kernel image.
```

## base_external/package/ldd/Config.in
```kconfig
config BR2_PACKAGE_LDD
	bool "ldd"
	depends on BR2_LINUX_KERNEL
	help
	  Includes the hello world linux device driver in the kernel image.
	  Used to understand linux device driver programming.
```
